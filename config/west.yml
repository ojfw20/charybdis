## config/west.yml
```yaml
manifest:
  remotes:
    - name: zmkfirmware
      url-base: https://github.com/ojfw20
  projects:
    - name: zmk
      remote: zmkfirmware
      revision: 9467719026d19835725d7dc539442709770a3967
      repo-path: zmkTrackballFork
      import: app/west.yml
  self:
    path: config
```
